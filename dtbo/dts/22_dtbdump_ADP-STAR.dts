/dts-v1/;

/ {
	model = "ADP-STAR";
	compatible = "qcom,sa8155-adp-star\0qcom,sa8155\0qcom,adp-star";
	qcom,board-id = <0x19 0x00>;

	fragment@0 {
		target = <0xffffffff>;

		__overlay__ {

			qcom,pm8150@0 {
				compatible = "qcom,spmi-pmic";
				reg = <0x00 0x00>;
				#address-cells = <0x02>;
				#size-cells = <0x00>;

				qcom,temp-alarm@2400 {
					compatible = "qcom,spmi-temp-alarm";
					reg = <0x2400 0x100>;
					interrupts = <0x00 0x24 0x00 0x01>;
					io-channels = <0x01 0x06>;
					io-channel-names = "thermal";
					#thermal-sensor-cells = <0x00>;
					qcom,temperature-threshold-set = <0x01>;
					phandle = <0x02>;
				};

				qcom,power-on@800 {
					compatible = "qcom,qpnp-power-on";
					reg = <0x800 0x100>;
					interrupts = <0x00 0x08 0x00 0x00 0x00 0x08 0x01 0x00 0x00 0x08 0x04 0x00 0x00 0x08 0x05 0x00>;
					interrupt-names = "kpdpwr\0resin\0resin-bark\0kpdpwr-resin-bark";
					qcom,pon-dbc-delay = <0xf424>;
					qcom,kpdpwr-sw-debounce;
					qcom,system-reset;
					qcom,store-hard-reset-reason;

					qcom,pon_1 {
						qcom,pon-type = <0x00>;
						qcom,support-reset = <0x01>;
						qcom,pull-up = <0x01>;
						linux,code = <0x74>;
						qcom,s1-timer = <0x1180>;
						qcom,s2-timer = <0x7d0>;
						qcom,s2-type = <0x07>;
					};

					qcom,pon_2 {
						qcom,pon-type = <0x01>;
						qcom,pull-up;
						linux,code = <0x72>;
					};

					qcom,pon_3 {
						qcom,pon-type = <0x03>;
						qcom,support-reset = <0x01>;
						qcom,pull-up = <0x01>;
						qcom,s1-timer = <0x548>;
						qcom,s2-timer = <0x7d0>;
						qcom,s2-type = <0x01>;
						qcom,use-bark;
					};
				};

				clock-controller@5b00 {
					compatible = "qcom,spmi-clkdiv";
					reg = <0x5b00 0x200>;
					#clock-cells = <0x01>;
					qcom,num-clkdivs = <0x02>;
					clock-output-names = "pm8150_1_div_clk1\0pm8150_1_div_clk2";
					clocks = <0xffffffff 0x00>;
					clock-names = "xo";
					phandle = <0x07>;
				};

				qcom,pm8150_rtc {
					compatible = "qcom,qpnp-rtc";
					#address-cells = <0x01>;
					#size-cells = <0x01>;
					qcom,qpnp-rtc-write = <0x00>;
					qcom,qpnp-rtc-alarm-pwrup = <0x01>;
					phandle = <0x08>;

					qcom,pm8150_rtc_rw@6000 {
						reg = <0x6000 0x100>;
					};

					qcom,pm8150_rtc_alarm@6100 {
						reg = <0x6100 0x100>;
						interrupts = <0x00 0x61 0x01 0x00>;
					};
				};

				pinctrl@c000 {
					compatible = "qcom,spmi-gpio";
					reg = <0xc000 0xa00>;
					interrupts = <0x00 0xc0 0x00 0x00 0x00 0xc2 0x00 0x00 0x00 0xc3 0x00 0x00 0x00 0xc5 0x00 0x00 0x00 0xc8 0x00 0x00 0x00 0xc9 0x00 0x00>;
					interrupt-names = "pm8150_1_gpio1\0pm8150_1_gpio3\0pm8150_1_gpio4\0pm8150_1_gpio6\0pm8150_1_gpio9\0pm8150_1_gpio10";
					gpio-controller;
					#gpio-cells = <0x02>;
					qcom,gpios-disallowed = <0x02 0x05 0x07 0x08>;
					phandle = <0x05>;

					key_home {

						key_home_default {
							pins = "gpio1";
							function = "normal";
							input-enable;
							bias-pull-up;
							power-source = <0x00>;
							phandle = <0x03>;
						};
					};

					storage_sd_detect {

						storage_cd_default {
							pins = "gpio4";
							function = "normal";
							input-enable;
							bias-pull-up;
							power-source = <0x00>;
							phandle = <0x06>;
						};
					};

					key_vol_up {

						key_vol_up_default {
							pins = "gpio6";
							function = "normal";
							input-enable;
							bias-pull-up;
							power-source = <0x01>;
							phandle = <0x04>;
						};
					};
				};

				sdam@b100 {
					compatible = "qcom,spmi-sdam";
					reg = <0xb100 0x100>;
					phandle = <0x09>;
				};

				vadc@3100 {
					compatible = "qcom,spmi-adc5";
					reg = <0x3100 0x100>;
					#address-cells = <0x01>;
					#size-cells = <0x00>;
					interrupts = <0x00 0x31 0x00 0x01>;
					interrupt-names = "eoc-int-en-set";
					qcom,adc-vdd-reference = <0x753>;
					#io-channel-cells = <0x01>;
					io-channel-ranges;
					phandle = <0x01>;

					ref_gnd {
						reg = <0x00>;
						label = "ref_gnd";
						qcom,pre-scaling = <0x01 0x01>;
					};

					vref_1p25 {
						reg = <0x01>;
						label = "vref_1p25";
						qcom,pre-scaling = <0x01 0x01>;
					};

					die_temp {
						reg = <0x06>;
						label = "die_temp";
						qcom,pre-scaling = <0x01 0x01>;
					};
				};

				adc_tm@3500 {
					compatible = "qcom,adc-tm5";
					reg = <0x3500 0x100>;
					interrupts = <0x00 0x35 0x00 0x01>;
					interrupt-names = "thr-int-en";
					#address-cells = <0x01>;
					#size-cells = <0x00>;
					#thermal-sensor-cells = <0x01>;
					io-channels = <0x01 0x4c 0x01 0x4d 0x01 0x4e>;
					phandle = <0x0a>;
				};
			};

			qcom,pm8150@1 {
				compatible = "qcom,spmi-pmic";
				reg = <0x01 0x00>;
				#address-cells = <0x02>;
				#size-cells = <0x00>;
			};
		};
	};

	fragment@1 {
		target = <0xffffffff>;

		__overlay__ {

			pm8150_tz {
				polling-delay-passive = <0x00>;
				polling-delay = <0x00>;
				thermal-governor = "step_wise";
				thermal-sensors = <0x02>;
				phandle = <0x0b>;

				trips {

					trip0 {
						temperature = <0x17318>;
						hysteresis = <0x00>;
						type = "passive";
						phandle = <0x0c>;
					};

					trip1 {
						temperature = <0x1c138>;
						hysteresis = <0x00>;
						type = "passive";
						phandle = <0x0d>;
					};

					trip2 {
						temperature = <0x23668>;
						hysteresis = <0x00>;
						type = "passive";
					};
				};
			};
		};
	};

	fragment@2 {
		target = <0xffffffff>;

		__overlay__ {

			qcom,pm8150@4 {
				compatible = "qcom,spmi-pmic";
				reg = <0x04 0x00>;
				#address-cells = <0x01>;
				#size-cells = <0x01>;

				qcom,power-on@800 {
					compatible = "qcom,qpnp-power-on";
					reg = <0x800 0x100>;
				};

				clock-controller@5b00 {
					compatible = "qcom,spmi-clkdiv";
					reg = <0x5b00 0x200>;
					#clock-cells = <0x01>;
					qcom,num-clkdivs = <0x02>;
					clock-output-names = "pm8150_2_div_clk1\0pm8150_2_div_clk2";
					clocks = <0xffffffff 0x00>;
					clock-names = "xo";
					phandle = <0x0e>;
				};

				pinctrl@c000 {
					compatible = "qcom,spmi-gpio";
					reg = <0xc000 0xa00>;
					interrupts = <0x04 0xc0 0x00 0x00 0x04 0xc2 0x00 0x00 0x04 0xc3 0x00 0x00 0x04 0xc5 0x00 0x00 0x04 0xc7 0x00 0x00 0x04 0xc8 0x00 0x00 0x04 0xc9 0x00 0x00>;
					interrupt-names = "pm8150_2_gpio1\0pm8150_2_gpio3\0pm8150_2_gpio4\0pm8150_2_gpio6\0pm8150_2_gpio8\0pm8150_2_gpio9\0pm8150_2_gpio10";
					gpio-controller;
					#gpio-cells = <0x02>;
					qcom,gpios-disallowed = <0x02 0x05 0x07>;
					phandle = <0x0f>;
				};
			};

			qcom,pm8150@5 {
				compatible = "qcom,spmi-pmic";
				reg = <0x05 0x00>;
				#address-cells = <0x01>;
				#size-cells = <0x01>;
			};
		};
	};

	fragment@3 {
		target = <0xffffffff>;

		__overlay__ {
			status = "ok";

			can-controller@0 {
				compatible = "qcom,nxp,mpc5746c";
				reg = <0x00>;
				interrupt-parent = <0xffffffff>;
				interrupts = <0x26 0x00>;
				spi-max-frequency = <0x4c4b40>;
				qcom,clk-freq-mhz = <0x2625a00>;
				qcom,max-can-channels = <0x01>;
				qcom,bits-per-word = <0x08>;
				qcom,support-can-fd;
			};
		};
	};

	fragment@4 {
		target = <0xffffffff>;

		__overlay__ {
			status = "ok";
		};
	};

	fragment@5 {
		target = <0xffffffff>;

		__overlay__ {
			status = "ok";
		};
	};

	fragment@6 {
		target = <0xffffffff>;

		__overlay__ {
			status = "ok";
		};
	};

	fragment@7 {
		target = <0xffffffff>;

		__overlay__ {
			status = "ok";
		};
	};

	fragment@8 {
		target = <0xffffffff>;

		__overlay__ {
			status = "disabled";
		};
	};

	fragment@9 {
		target = <0xffffffff>;

		__overlay__ {

			qcom,lpass@17300000 {
				status = "ok";
			};

			qcom,ssc@5c00000 {
				status = "disabled";
			};

			qcom,glink {

				modem {
					status = "disabled";
				};
			};

			qcom,turing@8300000 {
				status = "ok";
			};

			qcom,venus@aae0000 {
				status = "ok";
			};

			qcom,spss@1880000 {
				status = "ok";
			};

			qcom,npu@0x9800000 {
				status = "ok";
			};

			qcom,rmnet-ipa {
				status = "ok";
			};

			qcom,ipa_fws {
				status = "ok";
			};

			qcom,msm-cdsp-loader {
				status = "ok";
			};

			qcom,msm-ssc-sensors {
				status = "disabled";
				phandle = <0x10>;
			};

			qcom,ipa@1e00000 {
				status = "ok";
				phandle = <0x11>;
			};

			gpio_keys {
				compatible = "gpio-keys";
				label = "gpio-keys";
				pinctrl-names = "default";
				pinctrl-0 = <0x03 0x04>;

				home {
					label = "home";
					gpios = <0x05 0x01 0x01>;
					linux,input-type = <0x01>;
					linux,code = <0x66>;
					gpio-key,wakeup;
					debounce-interval = <0x0f>;
					linux,can-disable;
				};

				vol_up {
					label = "volume_up";
					gpios = <0x05 0x06 0x01>;
					linux,input-type = <0x01>;
					linux,code = <0x73>;
					gpio-key,wakeup;
					debounce-interval = <0x0f>;
					linux,can-disable;
				};
			};

			bt_qca6174 {
				status = "ok";
				phandle = <0x12>;
			};
		};
	};

	fragment@10 {
		target = <0xffffffff>;

		__overlay__ {
			compatible = "qcom,ufs-phy-qmp-v4";
			vdda-pll-supply = <0xffffffff>;
			vdda-phy-max-microamp = <0x1543c>;
			vdda-pll-max-microamp = <0x477c>;
			status = "ok";
		};
	};

	fragment@11 {
		target = <0xffffffff>;

		__overlay__ {
			vdd-hba-supply = <0xffffffff>;
			vdd-hba-fixed-regulator;
			vcc-supply = <0xffffffff>;
			vcc-voltage-level = <0x2d0370 0x2d2a80>;
			vccq2-supply = <0xffffffff>;
			vcc-max-microamp = <0xb71b0>;
			vccq2-max-microamp = <0xb71b0>;
			qcom,vddp-ref-clk-supply = <0xffffffff>;
			qcom,vddp-ref-clk-max-microamp = <0x64>;
			qcom,disable-lpm;
			status = "ok";
		};
	};

	fragment@12 {
		target = <0xffffffff>;

		__overlay__ {
			vdd-supply = <0xffffffff>;
			qcom,vdd-voltage-level = <0x2d0370 0x2d2a80>;
			qcom,vdd-current-level = <0xc8 0xc3500>;
			vdd-io-supply = <0xffffffff>;
			qcom,vdd-io-voltage-level = <0x1b9680 0x2d2a80>;
			qcom,vdd-io-current-level = <0xc8 0x55f0>;
			pinctrl-names = "active\0sleep";
			pinctrl-0 = <0xffffffff 0xffffffff 0xffffffff 0x06>;
			pinctrl-1 = <0xffffffff 0xffffffff 0xffffffff 0x06>;
			cd-gpios = <0x05 0x04 0x01>;
			status = "ok";
		};
	};

	fragment@13 {
		target = <0xffffffff>;

		__overlay__ {

			dwc3@a600000 {
				usb-phy = <0xffffffff 0xffffffff>;
				maximum-speed = "high-speed";
			};
		};
	};

	fragment@14 {
		target = <0xffffffff>;

		__overlay__ {
			status = "ok";

			dwc3@a800000 {
				dr_mode = "host";
			};
		};
	};

	fragment@15 {
		target = <0xffffffff>;

		__overlay__ {

			qcom,cam-res-mgr {
				compatible = "qcom,cam-res-mgr";
				status = "ok";
			};

			qcom,cam-sensor@0 {
				cell-index = <0x00>;
				compatible = "qcom,cam-sensor";
				reg = <0x00>;
				csiphy-sd-index = <0x00>;
				sensor-position-roll = <0x5a>;
				sensor-position-pitch = <0x00>;
				sensor-position-yaw = <0xb4>;
				cam_vio-supply = <0xffffffff>;
				cam_bob-supply = <0xffffffff>;
				cam_vana-supply = <0xffffffff>;
				cam_vdig-supply = <0xffffffff>;
				cam_clk-supply = <0xffffffff>;
				regulator-names = "cam_vio\0cam_vana\0cam_vdig\0cam_clk\0cam_bob";
				gpios = <0xffffffff 0x0d 0x00 0xffffffff 0x15 0x00>;
				gpio-reset = <0x01>;
				gpio-req-tbl-num = <0x00 0x01>;
				gpio-req-tbl-flags = <0x01 0x00>;
				gpio-req-tbl-label = "CAMIF_MCLK0\0CAM_RESET0";
				sensor-mode = <0x00>;
				cci-master = <0x00>;
				status = "ok";
				clocks = <0xffffffff 0x48>;
				clock-names = "cam_clk";
				clock-cntl-level = "turbo";
				clock-rates = <0x16e3600>;
			};

			qcom,cam-sensor@1 {
				cell-index = <0x01>;
				compatible = "qcom,cam-sensor";
				reg = <0x01>;
				csiphy-sd-index = <0x01>;
				sensor-position-roll = <0x5a>;
				sensor-position-pitch = <0x00>;
				sensor-position-yaw = <0xb4>;
				cam_bob-supply = <0xffffffff>;
				cam_vdig-supply = <0xffffffff>;
				cam_vio-supply = <0xffffffff>;
				cam_vana-supply = <0xffffffff>;
				cam_clk-supply = <0xffffffff>;
				regulator-names = "cam_vio\0cam_vana\0cam_vdig\0cam_clk\0cam_bob";
				gpios = <0xffffffff 0x0e 0x00 0xffffffff 0x16 0x00>;
				gpio-reset = <0x01>;
				gpio-req-tbl-num = <0x00 0x01>;
				gpio-req-tbl-flags = <0x01 0x00>;
				gpio-req-tbl-label = "CAMIF_MCLK1\0CAM_RESET1";
				sensor-mode = <0x00>;
				cci-master = <0x00>;
				status = "ok";
				clocks = <0xffffffff 0x4a>;
				clock-names = "cam_clk";
				clock-cntl-level = "turbo";
				clock-rates = <0x16e3600>;
			};

			qcom,cam-sensor@2 {
				cell-index = <0x02>;
				compatible = "qcom,cam-sensor";
				reg = <0x02>;
				csiphy-sd-index = <0x02>;
				sensor-position-roll = <0x5a>;
				sensor-position-pitch = <0x00>;
				sensor-position-yaw = <0x00>;
				cam_vio-supply = <0xffffffff>;
				cam_bob-supply = <0xffffffff>;
				cam_vana-supply = <0xffffffff>;
				cam_vdig-supply = <0xffffffff>;
				cam_clk-supply = <0xffffffff>;
				regulator-names = "cam_vio\0cam_vana\0cam_vdig\0cam_clk\0cam_bob";
				gpios = <0xffffffff 0x0f 0x00 0xffffffff 0x17 0x00>;
				gpio-reset = <0x01>;
				gpio-req-tbl-num = <0x00 0x01>;
				gpio-req-tbl-flags = <0x01 0x00>;
				gpio-req-tbl-label = "CAMIF_MCLK2\0CAM_RESET2";
				sensor-mode = <0x00>;
				cci-master = <0x01>;
				status = "ok";
				clocks = <0xffffffff 0x4c>;
				clock-names = "cam_clk";
				clock-cntl-level = "turbo";
				clock-rates = <0x16e3600>;
			};

			qcom,cam-sensor@3 {
				cell-index = <0x03>;
				compatible = "qcom,cam-sensor";
				reg = <0x03>;
				csiphy-sd-index = <0x03>;
				sensor-position-roll = <0x10e>;
				sensor-position-pitch = <0x00>;
				sensor-position-yaw = <0x00>;
				cam_vio-supply = <0xffffffff>;
				cam_bob-supply = <0xffffffff>;
				cam_vana-supply = <0xffffffff>;
				cam_vdig-supply = <0xffffffff>;
				cam_clk-supply = <0xffffffff>;
				regulator-names = "cam_vio\0cam_vana\0cam_vdig\0cam_clk\0cam_bob";
				gpios = <0xffffffff 0x10 0x00 0xffffffff 0x19 0x00>;
				gpio-reset = <0x01>;
				gpio-req-tbl-num = <0x00 0x01>;
				gpio-req-tbl-flags = <0x01 0x00>;
				gpio-req-tbl-label = "CAMIF_MCLK3\0CAM_RESET3";
				sensor-mode = <0x00>;
				cci-master = <0x01>;
				status = "ok";
				clocks = <0xffffffff 0x4e>;
				clock-names = "cam_clk";
				clock-cntl-level = "turbo";
				clock-rates = <0x16e3600>;
			};
		};
	};

	__symbols__ {
		pm8150_1_tz = "/fragment@0/__overlay__/qcom,pm8150@0/qcom,temp-alarm@2400";
		pm8150_tz = "/fragment@0/__overlay__/qcom,pm8150@0/qcom,temp-alarm@2400";
		pm8150_1_clkdiv = "/fragment@0/__overlay__/qcom,pm8150@0/clock-controller@5b00";
		pm8150_clkdiv = "/fragment@0/__overlay__/qcom,pm8150@0/clock-controller@5b00";
		pm8150_1_rtc = "/fragment@0/__overlay__/qcom,pm8150@0/qcom,pm8150_rtc";
		pm8150_rtc = "/fragment@0/__overlay__/qcom,pm8150@0/qcom,pm8150_rtc";
		pm8150_1_gpios = "/fragment@0/__overlay__/qcom,pm8150@0/pinctrl@c000";
		pm8150_gpios = "/fragment@0/__overlay__/qcom,pm8150@0/pinctrl@c000";
		key_home_default = "/fragment@0/__overlay__/qcom,pm8150@0/pinctrl@c000/key_home/key_home_default";
		storage_cd_default = "/fragment@0/__overlay__/qcom,pm8150@0/pinctrl@c000/storage_sd_detect/storage_cd_default";
		key_vol_up_default = "/fragment@0/__overlay__/qcom,pm8150@0/pinctrl@c000/key_vol_up/key_vol_up_default";
		pm8150_sdam_2 = "/fragment@0/__overlay__/qcom,pm8150@0/sdam@b100";
		pm8150_vadc = "/fragment@0/__overlay__/qcom,pm8150@0/vadc@3100";
		pm8150_adc_tm = "/fragment@0/__overlay__/qcom,pm8150@0/adc_tm@3500";
		pm8150_temp_alarm = "/fragment@1/__overlay__/pm8150_tz";
		pm8150_trip0 = "/fragment@1/__overlay__/pm8150_tz/trips/trip0";
		pm8150_trip1 = "/fragment@1/__overlay__/pm8150_tz/trips/trip1";
		pm8150_2_clkdiv = "/fragment@2/__overlay__/qcom,pm8150@4/clock-controller@5b00";
		pm8150_2_gpios = "/fragment@2/__overlay__/qcom,pm8150@4/pinctrl@c000";
		ssc_sensors = "/fragment@9/__overlay__/qcom,msm-ssc-sensors";
		ipa_hw = "/fragment@9/__overlay__/qcom,ipa@1e00000";
		bluetooth = "/fragment@9/__overlay__/bt_qca6174";
	};

	__fixups__ {
		spmi_bus = "/fragment@0:target:0\0/fragment@2:target:0";
		clock_rpmh = "/fragment@0/__overlay__/qcom,pm8150@0/clock-controller@5b00:clocks:0\0/fragment@2/__overlay__/qcom,pm8150@4/clock-controller@5b00:clocks:0";
		thermal_zones = "/fragment@1:target:0";
		qupv3_se0_spi = "/fragment@3:target:0";
		tlmm = "/fragment@3/__overlay__/can-controller@0:interrupt-parent:0\0/fragment@15/__overlay__/qcom,cam-sensor@0:gpios:0\0/fragment@15/__overlay__/qcom,cam-sensor@0:gpios:12\0/fragment@15/__overlay__/qcom,cam-sensor@1:gpios:0\0/fragment@15/__overlay__/qcom,cam-sensor@1:gpios:12\0/fragment@15/__overlay__/qcom,cam-sensor@2:gpios:0\0/fragment@15/__overlay__/qcom,cam-sensor@2:gpios:12\0/fragment@15/__overlay__/qcom,cam-sensor@3:gpios:0\0/fragment@15/__overlay__/qcom,cam-sensor@3:gpios:12";
		qupv3_se12_2uart = "/fragment@4:target:0";
		qupv3_se13_4uart = "/fragment@5:target:0";
		qupv3_se3_spi = "/fragment@6:target:0";
		qupv3_se4_i2c = "/fragment@7:target:0";
		pil_modem = "/fragment@8:target:0";
		soc = "/fragment@9:target:0";
		ufsphy_mem = "/fragment@10:target:0";
		pm8150_2_l8 = "/fragment@10/__overlay__:vdda-pll-supply:0";
		ufshc_mem = "/fragment@11:target:0";
		ufs_phy_gdsc = "/fragment@11/__overlay__:vdd-hba-supply:0";
		pm8150_1_l10 = "/fragment@11/__overlay__:vcc-supply:0";
		pm8150_1_s4 = "/fragment@11/__overlay__:vccq2-supply:0\0/fragment@15/__overlay__/qcom,cam-sensor@0:cam_vio-supply:0\0/fragment@15/__overlay__/qcom,cam-sensor@0:cam_bob-supply:0\0/fragment@15/__overlay__/qcom,cam-sensor@0:cam_vana-supply:0\0/fragment@15/__overlay__/qcom,cam-sensor@0:cam_vdig-supply:0\0/fragment@15/__overlay__/qcom,cam-sensor@1:cam_bob-supply:0\0/fragment@15/__overlay__/qcom,cam-sensor@1:cam_vdig-supply:0\0/fragment@15/__overlay__/qcom,cam-sensor@1:cam_vio-supply:0\0/fragment@15/__overlay__/qcom,cam-sensor@1:cam_vana-supply:0\0/fragment@15/__overlay__/qcom,cam-sensor@2:cam_vio-supply:0\0/fragment@15/__overlay__/qcom,cam-sensor@2:cam_bob-supply:0\0/fragment@15/__overlay__/qcom,cam-sensor@2:cam_vana-supply:0\0/fragment@15/__overlay__/qcom,cam-sensor@2:cam_vdig-supply:0\0/fragment@15/__overlay__/qcom,cam-sensor@3:cam_vio-supply:0\0/fragment@15/__overlay__/qcom,cam-sensor@3:cam_bob-supply:0\0/fragment@15/__overlay__/qcom,cam-sensor@3:cam_vana-supply:0\0/fragment@15/__overlay__/qcom,cam-sensor@3:cam_vdig-supply:0";
		pm8150_2_l5 = "/fragment@11/__overlay__:qcom,vddp-ref-clk-supply:0";
		sdhc_2 = "/fragment@12:target:0";
		pm8150_1_l17 = "/fragment@12/__overlay__:vdd-supply:0";
		pm8150_2_l13 = "/fragment@12/__overlay__:vdd-io-supply:0";
		sdc2_clk_on = "/fragment@12/__overlay__:pinctrl-0:0";
		sdc2_cmd_on = "/fragment@12/__overlay__:pinctrl-0:4";
		sdc2_data_on = "/fragment@12/__overlay__:pinctrl-0:8";
		sdc2_clk_off = "/fragment@12/__overlay__:pinctrl-1:0";
		sdc2_cmd_off = "/fragment@12/__overlay__:pinctrl-1:4";
		sdc2_data_off = "/fragment@12/__overlay__:pinctrl-1:8";
		usb0 = "/fragment@13:target:0";
		usb2_phy0 = "/fragment@13/__overlay__/dwc3@a600000:usb-phy:0";
		usb_nop_phy = "/fragment@13/__overlay__/dwc3@a600000:usb-phy:4";
		usb1 = "/fragment@14:target:0";
		cam_cci0 = "/fragment@15:target:0";
		titan_top_gdsc = "/fragment@15/__overlay__/qcom,cam-sensor@0:cam_clk-supply:0\0/fragment@15/__overlay__/qcom,cam-sensor@1:cam_clk-supply:0\0/fragment@15/__overlay__/qcom,cam-sensor@2:cam_clk-supply:0\0/fragment@15/__overlay__/qcom,cam-sensor@3:cam_clk-supply:0";
		clock_camcc = "/fragment@15/__overlay__/qcom,cam-sensor@0:clocks:0\0/fragment@15/__overlay__/qcom,cam-sensor@1:clocks:0\0/fragment@15/__overlay__/qcom,cam-sensor@2:clocks:0\0/fragment@15/__overlay__/qcom,cam-sensor@3:clocks:0";
	};

	__local_fixups__ {

		fragment@0 {

			__overlay__ {

				qcom,pm8150@0 {

					qcom,temp-alarm@2400 {
						io-channels = <0x00>;
					};

					adc_tm@3500 {
						io-channels = <0x00 0x08 0x10>;
					};
				};
			};
		};

		fragment@1 {

			__overlay__ {

				pm8150_tz {
					thermal-sensors = <0x00>;
				};
			};
		};

		fragment@9 {

			__overlay__ {

				gpio_keys {
					pinctrl-0 = <0x00 0x04>;

					home {
						gpios = <0x00>;
					};

					vol_up {
						gpios = <0x00>;
					};
				};
			};
		};

		fragment@12 {

			__overlay__ {
				pinctrl-0 = <0x0c>;
				pinctrl-1 = <0x0c>;
				cd-gpios = <0x00>;
			};
		};
	};
};
